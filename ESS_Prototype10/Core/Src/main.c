/* USER CODE BEGIN Header */
/* ============================================================================
 * Final Exam Project - IoT Prototype: Smart Sensing via LoRa.
 * Board: NUCLEO-G071RB + BME680 (I2C) + SX1262 LoRa HAT (SPI)
 * Group : 6
 * Student: Ridham Pansara
 * Date: 22 July 2025
 * Description:
 *   - Reads environmental data from BME680 over I2C
 *   - UART CLI for user commands (PuTTY)
 *   - Controls LoRa module (SX1262) over SPI (send Sensor Data and message)
 * ========================================================================== */
/* USER CODE END Header */
/* Includes ------------------------------------------------------------------*/
#include "main.h"           // Core STM32 includes, generated by CubeMX
#include "i2c.h"            // I2C interface for BME680 sensor
#include "spi.h"            // SPI interface for LoRa HAT
#include "usart.h"          // USART2 for UART CLI
#include "gpio.h"           // GPIO for pin controls

/* Private includes ----------------------------------------------------------*/
/* USER CODE BEGIN Includes */
#include "bme68x.h"         // Bosch BME680 sensor driver
#include "bme68x_defs.h"    // Extra BME680 definitions
#include <stdio.h>          // Standard C input/output
#include <string.h>         // String handling (for command parsing)
#include <math.h>           // Math library (not strictly needed, but safe)
/* USER CODE END Includes */

/* Private typedef -----------------------------------------------------------*/
/* USER CODE BEGIN PTD */

/* USER CODE END PTD */

/* Private define ------------------------------------------------------------*/
/* USER CODE BEGIN PD */
// === Pin/Peripheral Defines ===
#define BME68X_I2C_ADDR        0x77                // I2C address for BME680
#define LORA_NSS_Pin           GPIO_PIN_8          // Chip select (SPI NSS) pin for LoRa
#define LORA_NSS_GPIO_Port     GPIOA               // NSS pin port
#define LORA_BUSY_Pin          GPIO_PIN_4          // LoRa BUSY signal pin
#define LORA_BUSY_GPIO_Port    GPIOB               // BUSY pin port
#define LORA_RST_Pin           GPIO_PIN_5          // LoRa RESET pin
#define LORA_RST_GPIO_Port     GPIOB               // RESET pin port



/* USER CODE END PD */

/* Private macro -------------------------------------------------------------*/
/* USER CODE BEGIN PM */

/* USER CODE END PM */

/* Private variables ---------------------------------------------------------*/

/* USER CODE BEGIN PV */
// Handles created by CubeMX auto code
extern I2C_HandleTypeDef hi2c1;    // I2C1 handle for BME680
extern UART_HandleTypeDef huart2;  // UART2 handle for PC CLI
extern SPI_HandleTypeDef hspi2;    // SPI2 handle for LoRa HAT


// === Global Variables for Sensor and CLI State ===
struct bme68x_dev bme;                 // BME680 device struct for Bosch API
struct bme68x_conf conf;               // Configuration struct for BME680
struct bme68x_heatr_conf heatr_conf;   // Heater config for BME680
struct bme68x_data data;               // Holds latest measurement

uint8_t rx_byte;                       // Holds each byte received over UART
char command_buffer[32];               // Buffer to collect one user command
uint8_t cmd_index = 0;                 // Tracks where to store next character
/* USER CODE END PV */

/* Private function prototypes -----------------------------------------------*/
void SystemClock_Config(void);
/* USER CODE BEGIN PFP */
// --- LoRa function prototypes ---
void LoRa_Select(void);
void LoRa_Unselect(void);
void LoRa_WaitWhileBusy(void);
void LoRa_WriteCommand(uint8_t cmd, uint8_t *data, uint16_t len);
void LoRa_SendString(const char* str);
void LoRa_SetStandby(void);
void LoRa_SetPacketType(void);
void LoRa_SetRfFrequency(uint32_t frequency_hz);
void LoRa_SetBufferBaseAddress(void);
void LoRa_SetModulationParams(void);
void LoRa_SetPacketParams(uint8_t payload_length);
void LoRa_SetTxParams(void);
void LoRa_SendString(const char* str);
void LoRa_Reset(void);
void LoRa_Init(void);
void LoRa_PrintStatus(void);
uint8_t LoRa_GetStatus(void);

/* USER CODE END PFP */

/* Private user code ---------------------------------------------------------*/
/* USER CODE BEGIN 0 */
/* ============================================================================
 * This function reroutes printf output to the UART (so it prints in PuTTY)
 * ========================================================================= */
int _write(int file, char *ptr, int len) {
    HAL_UART_Transmit(&huart2, (uint8_t*)ptr, len, HAL_MAX_DELAY); // Send buffer over UART2
    return len; // Return the number of bytes "written"
}




/* ============================================================================
 * BME680 - Bosch driver needs these callbacks for I2C and delay
 * ========================================================================= */
int8_t user_i2c_read(uint8_t reg_addr, uint8_t *data, uint32_t len, void *intf_ptr) {
    // Reads a register from BME680 using HAL I2C
    return HAL_I2C_Mem_Read((I2C_HandleTypeDef*)intf_ptr, BME68X_I2C_ADDR << 1, reg_addr,
                            I2C_MEMADD_SIZE_8BIT, data, len, HAL_MAX_DELAY) == HAL_OK ? 0 : -1;
}

int8_t user_i2c_write(uint8_t reg_addr, const uint8_t *data, uint32_t len, void *intf_ptr) {
    // Writes a register to BME680 using HAL I2C
    return HAL_I2C_Mem_Write((I2C_HandleTypeDef*)intf_ptr, BME68X_I2C_ADDR << 1, reg_addr,
                             I2C_MEMADD_SIZE_8BIT, (uint8_t*)data, len, HAL_MAX_DELAY) == HAL_OK ? 0 : -1;
}

void user_delay_us(uint32_t period, void *intf_ptr) {
    // Simple busy-wait for crude microsecond delay (good enough for sensor)
    for (volatile uint32_t i = 0; i < period * 10; i++) { __NOP(); }
}





/* ============================================================================
 * LoRa SPI Driver Functions (basic low-level SPI protocol for SX1262)
 * ========================================================================= */

// Activates the chip select pin for LoRa SPI (NSS LOW = active)
void LoRa_Select(void) {
    HAL_GPIO_WritePin(LORA_NSS_GPIO_Port, LORA_NSS_Pin, GPIO_PIN_RESET);
}

// Deactivates the chip select pin for LoRa SPI (NSS HIGH = inactive)
void LoRa_Unselect(void) {
    HAL_GPIO_WritePin(LORA_NSS_GPIO_Port, LORA_NSS_Pin, GPIO_PIN_SET);
}

// Waits until LoRa's BUSY pin goes low (module is ready for next SPI op)
void LoRa_WaitWhileBusy(void) {
    uint32_t timeout = HAL_GetTick() + 1000;  // 1 second timeout
    while (HAL_GPIO_ReadPin(LORA_BUSY_GPIO_Port, LORA_BUSY_Pin) == GPIO_PIN_SET) {
        if (HAL_GetTick() > timeout) {
            printf("[ERROR] BUSY timeout!\r\n");
            break; // exit while loop if stuck
        }
    }
}

// Issues a hardware reset pulse to the LoRa HAT (required for init)
void LoRa_Reset(void) {
    HAL_GPIO_WritePin(LORA_RST_GPIO_Port, LORA_RST_Pin, GPIO_PIN_RESET); // Set RESET low
    HAL_Delay(10);                                                       // Wait 10ms
    HAL_GPIO_WritePin(LORA_RST_GPIO_Port, LORA_RST_Pin, GPIO_PIN_SET);   // Set RESET high
    HAL_Delay(10);                                                       // Wait again
}


// Fully initialize/configure the SX1262 LoRa module.
void LoRa_Init(void) {
    LoRa_SetStandby();            // Standby mode (required for config)
    LoRa_SetPacketType();         // Set to LoRa packet type
    LoRa_SetRfFrequency(868000000); // Set EU ISM band, adjust if needed
    LoRa_SetBufferBaseAddress();  // TX/RX buffer address to 0
    LoRa_SetModulationParams();   // SF7/BW125/CR4_5
    LoRa_SetPacketParams(16);     // Default 16-byte payload, adjust as needed
    LoRa_SetTxParams();           // Output power, ramp time
    printf("LoRa: Module initialized.\r\n");
}

// Print the status of the SX126x chip.
void LoRa_PrintStatus(void) {
    uint8_t status = LoRa_GetStatus();
    printf("SX126x Status: 0x%02X\r\n", status);
}


// Sends a SPI command plus data payload to the LoRa chip
void LoRa_WriteCommand(uint8_t cmd, uint8_t *data, uint16_t len) {
    LoRa_WaitWhileBusy();                            // Wait until module is ready
    LoRa_Select();                                   // Activate NSS
    HAL_SPI_Transmit(&hspi2, &cmd, 1, 100);          // Send the command byte
    HAL_SPI_Transmit(&hspi2, data, len, 100);        // Send any extra data bytes
    LoRa_Unselect();                                 // Deactivate NSS
    LoRa_WaitWhileBusy();                            // Wait again for completion
}

// Puts LoRa module in standby (must be done before config/tx)
void LoRa_SetStandby(void) {
    uint8_t cmd[] = { 0x01, 0x00 }; // 0x01 = STDBY_RC mode
    LoRa_WriteCommand(0x80, cmd, sizeof(cmd)); // 0x80 = SetStandby command
}

// Tells LoRa to use LoRa modulation (not FSK)
void LoRa_SetPacketType(void) {
    uint8_t cmd[] = { 0x01 }; // 0x01 = LoRa packet
    LoRa_WriteCommand(0x8A, cmd, sizeof(cmd)); // 0x8A = SetPacketType
}

// Sets carrier frequency for LoRa (e.g., 868 MHz for Europe)
void LoRa_SetRfFrequency(uint32_t frequency_hz) {
    // Convert freq to SX1262 register format
    uint32_t freq = (uint32_t)((double)frequency_hz / 32000000.0 * (1 << 25));
    uint8_t cmd[] = {
        (uint8_t)(freq >> 24),
        (uint8_t)(freq >> 16),
        (uint8_t)(freq >> 8),
        (uint8_t)(freq >> 0)
    };
    LoRa_WriteCommand(0x86, cmd, sizeof(cmd)); // 0x86 = SetRfFrequency
}

// Sets output power and ramp time for transmission
void LoRa_SetTxParams(void) {
    uint8_t cmd[] = { 0x0F, 0xE0 }; // 0x0F = 15dBm, 0xE0 = 200us ramp
    LoRa_WriteCommand(0x8E, cmd, sizeof(cmd)); // 0x8E = SetTxParams
}

// Set buffer base address for both TX and RX (usually both 0)
void LoRa_SetBufferBaseAddress(void) {
    uint8_t cmd[] = { 0x00, 0x00 }; // TX base = 0x00, RX base = 0x00
    LoRa_WriteCommand(0x8F, cmd, sizeof(cmd)); // 0x8F = SetBufferBaseAddress
}

// Sets spreading factor, bandwidth, and coding rate (standard LoRa: SF7, 125kHz, CR4/5)
void LoRa_SetModulationParams(void) {
    uint8_t cmd[] = { 0x07, 0x04, 0x01 }; // SF7, 125kHz, CR 4/5
    LoRa_WriteCommand(0x8B, cmd, sizeof(cmd)); // 0x8B = SetModulationParams
}

// Packet parameters: preamble, explicit header, payload length, no CRC, standard IQ
void LoRa_SetPacketParams(uint8_t payload_length) {
    uint8_t cmd[] = { 0x08, 0x00, payload_length, 0x00, 0x00 };
    LoRa_WriteCommand(0x8C, cmd, sizeof(cmd)); // 0x8C = SetPacketParams
}

// Sends a string as LoRa packet (all config done each time for safety)
void LoRa_SendString(const char* str) {
    uint8_t buffer[256];                                  // Holds transmit payload
    uint8_t length = strlen(str);                         // Actual length of message
    buffer[0] = 0x00;                                     // Offset for write buffer
    memcpy(&buffer[1], str, length);                      // Copy message into buffer (after offset byte)

    LoRa_SetStandby();                                    // Required before configuration
    LoRa_SetPacketType();                                 // Use LoRa modulation
    LoRa_SetRfFrequency(868000000);                       // Set frequency to 868 MHz (EU)
    LoRa_SetBufferBaseAddress();                          // Start buffer at 0
    LoRa_SetModulationParams();                           // SF7/125kHz/CR4/5
    LoRa_SetPacketParams(length);                         // Set payload length
    LoRa_SetTxParams();                                   // Set TX power, ramp

    LoRa_WriteCommand(0x0E, buffer, length + 1);          // 0x0E = WriteBuffer command

    uint8_t tx_cmd[] = { 0x00, 0x00 };                    // Trigger TX, 0 = blocking
    LoRa_WriteCommand(0x83, tx_cmd, sizeof(tx_cmd));      // 0x83 = SetTx

    printf("LoRa: Sent '%s'\r\n", str);                   // Print confirmation to UART
}


// Reads the status register from the SX126x LoRa radio via SPI.
// This sends the GetStatus command (0xC0) and retrieves the status byte.
// uint8_t  The status byte read from the LoRa module.
uint8_t LoRa_GetStatus(void) {
    uint8_t cmd = 0xC0;       // 0xC0 is the GetStatus command for SX126x
    uint8_t dummy = 0x00;     // Dummy byte, required for clocking data out
    uint8_t status = 0;       // Variable to hold the status returned

    LoRa_Select();                                            // Pull NSS (chip select) low to begin SPI transaction
    HAL_SPI_Transmit(&hspi2, &cmd, 1, HAL_MAX_DELAY);         // Send the GetStatus command (0xC0)
    HAL_SPI_Transmit(&hspi2, &dummy, 1, HAL_MAX_DELAY);       // Send a dummy byte (required by SX126x protocol)
    HAL_SPI_Receive(&hspi2, &status, 1, HAL_MAX_DELAY);       // Receive the status byte from the LoRa module
    LoRa_Unselect();                                          // Pull NSS (chip select) high to end SPI transaction

    return status;                                            // Return the received status byte
}




/* ============================================================================
 * Initializes the BME680 sensor over I2C and sets config
 * ========================================================================= */
void BME680_Init(void) {
    bme.intf = BME68X_I2C_INTF;                   // Use I2C
    bme.read = user_i2c_read;                     // Attach I2C read callback
    bme.write = user_i2c_write;                   // Attach I2C write callback
    bme.delay_us = user_delay_us;                 // Attach delay callback
    bme.intf_ptr = &hi2c1;                        // Give Bosch API the I2C handle

    if (bme68x_init(&bme) != BME68X_OK) {         // Initialize sensor, fail if not OK
        printf("BME680 init failed!\r\n");
        while (1);
    }
    conf.os_temp = BME68X_OS_8X;                  // Set temperature oversampling (8x)
    conf.os_pres = BME68X_OS_4X;                  // Set pressure oversampling (4x)
    conf.os_hum = BME68X_OS_2X;                   // Set humidity oversampling (2x)
    conf.filter = BME68X_FILTER_SIZE_3;           // Set IIR filter size
    conf.odr = BME68X_ODR_NONE;                   // No periodic output
    bme68x_set_conf(&conf, &bme);                 // Send config to sensor

    heatr_conf.enable = BME68X_ENABLE;            // Turn on gas heater
    heatr_conf.heatr_temp = 320;                  // Heater temp (°C)
    heatr_conf.heatr_dur = 150;                   // Heater duration (ms)
    bme68x_set_heatr_conf(BME68X_FORCED_MODE, &heatr_conf, &bme); // Set heater

    printf("BME680 Initialized.\r\n");            // Confirmation on UART
}





/* ============================================================================
 * Main CLI command handler - interprets user's command strings
 * ========================================================================= */
void handle_command(char *cmd) {

	// --- Basic Math Operations (SUM, SUB, MUL, DIV) ---
	    int a, b, n;
	    if (sscanf(cmd, "SUM %d %d%n", &a, &b, &n) == 2 && n == strlen(cmd)) {
	        printf("Result: %d\r\n", a + b);
	        return;
	    }
	    if (sscanf(cmd, "SUB %d %d%n", &a, &b, &n) == 2 && n == strlen(cmd)) {
	        printf("Result: %d\r\n", a - b);
	        return;
	    }
	    if (sscanf(cmd, "MUL %d %d%n", &a, &b, &n) == 2 && n == strlen(cmd)) {
	        printf("Result: %d\r\n", a * b);
	        return;
	    }
	    if (sscanf(cmd, "DIV %d %d%n", &a, &b, &n) == 2 && n == strlen(cmd)) {
	        if (b == 0) {
	            printf("Error: Division by zero!\r\n");
	        } else {
	            printf("Result: %d\r\n", a / b);
	        }
	        return;
	    }




	if (strcmp(cmd, "START") == 0) {
	        // (Your startup logic here)
	        // init LoRa, BME680, print banner, commands, etc.
	        LoRa_Reset();
	        LoRa_SetStandby();
	        LoRa_SetPacketType();
	        LoRa_SetRfFrequency(868000000);
	        LoRa_SetBufferBaseAddress();
	        LoRa_SetModulationParams();
	        LoRa_SetPacketParams(8);
	        LoRa_SetTxParams();



	        printf("\r\n========== IoT Prototype: Smart Sensing via LoRa. ==========\r\n");
	        printf("BUSY pin state: %d\r\n", HAL_GPIO_ReadPin(LORA_BUSY_GPIO_Port, LORA_BUSY_Pin));
	        uint8_t lora_status = LoRa_GetStatus();
	        printf("LoRa Status: 0x%02X\r\n", lora_status);

	        BME680_Init();
	        HAL_Delay(500);

	        printf("IoT Prototype: CLI Started\r\n");
	        printf("Type TEMP, HUM, PRESS, GAS, ALL, LORA SEND <cmd> and <msg>, LORA STATUS, LORA INIT, LORA RESET, SUM, SUB, MUL, DIV, START and hit Enter\r\n\r\n");
	        return;
	    }

    // "LORA SEND ALL": Transmit all sensor values via LoRa.
	    else if (strcmp(cmd, "LORA SEND ALL") == 0) {
        bme68x_set_op_mode(BME68X_FORCED_MODE, &bme); // Start forced measurement on BME680
        uint32_t delay_us = bme68x_get_meas_dur(BME68X_FORCED_MODE, &conf, &bme) + heatr_conf.heatr_dur * 1000; // Calculate measurement time
        user_delay_us(delay_us, bme.intf_ptr); // Wait for measurement to finish
        uint8_t n_fields = 0; // To store number of valid data fields
        if (bme68x_get_data(BME68X_FORCED_MODE, &data, &n_fields, &bme) != BME68X_OK || n_fields == 0) {
            printf("Sensor data not available.\r\n"); // Error if no data
            return;
        }
        char lora_msg[80]; // Buffer for LoRa message
        snprintf(lora_msg, sizeof(lora_msg), "T:%.2f,H:%.2f,P:%.2f,G:%.2f",
                 data.temperature, data.humidity, data.pressure / 100.0f, (float)data.gas_resistance); // Format all data
        LoRa_SendString(lora_msg); // Send over LoRa
     //   printf("LoRa: Sent sensor data: %s\r\n", lora_msg); // Print what was sent
        return;
    }

    // "LORA SEND TEMP": Transmit only temperature value via LoRa.
    else if (strcmp(cmd, "LORA SEND TEMP") == 0) {
        bme68x_set_op_mode(BME68X_FORCED_MODE, &bme); // Start forced measurement
        uint32_t delay_us = bme68x_get_meas_dur(BME68X_FORCED_MODE, &conf, &bme) + heatr_conf.heatr_dur * 1000; // Delay
        user_delay_us(delay_us, bme.intf_ptr); // Wait
        uint8_t n_fields = 0;
        if (bme68x_get_data(BME68X_FORCED_MODE, &data, &n_fields, &bme) != BME68X_OK || n_fields == 0) {
            printf("Sensor data not available.\r\n");
            return;
        }
        char lora_msg[32];
        snprintf(lora_msg, sizeof(lora_msg), "T:%.2f", data.temperature); // Format temperature
        LoRa_SendString(lora_msg); // Send over LoRa
     //   printf("LoRa: Sent temperature: %s\r\n", lora_msg); // Print sent value
        return;
    }

    // "LORA SEND HUM": Transmit only humidity value via LoRa.
    else if (strcmp(cmd, "LORA SEND HUM") == 0) {
        bme68x_set_op_mode(BME68X_FORCED_MODE, &bme); // Start measurement
        uint32_t delay_us = bme68x_get_meas_dur(BME68X_FORCED_MODE, &conf, &bme) + heatr_conf.heatr_dur * 1000; // Delay
        user_delay_us(delay_us, bme.intf_ptr); // Wait
        uint8_t n_fields = 0;
        if (bme68x_get_data(BME68X_FORCED_MODE, &data, &n_fields, &bme) != BME68X_OK || n_fields == 0) {
            printf("Sensor data not available.\r\n");
            return;
        }
        char lora_msg[32];
        snprintf(lora_msg, sizeof(lora_msg), "H:%.2f", data.humidity); // Format humidity
        LoRa_SendString(lora_msg); // Send over LoRa
      //  printf("LoRa: Sent humidity: %s\r\n", lora_msg);
        return;
    }

    // "LORA SEND PRESS": Transmit only pressure value via LoRa.
    else if (strcmp(cmd, "LORA SEND PRESS") == 0) {
        bme68x_set_op_mode(BME68X_FORCED_MODE, &bme); // Start measurement
        uint32_t delay_us = bme68x_get_meas_dur(BME68X_FORCED_MODE, &conf, &bme) + heatr_conf.heatr_dur * 1000; // Delay
        user_delay_us(delay_us, bme.intf_ptr); // Wait
        uint8_t n_fields = 0;
        if (bme68x_get_data(BME68X_FORCED_MODE, &data, &n_fields, &bme) != BME68X_OK || n_fields == 0) {
            printf("Sensor data not available.\r\n");
            return;
        }
        char lora_msg[32];
        snprintf(lora_msg, sizeof(lora_msg), "P:%.2f", data.pressure / 100.0f); // Format pressure
        LoRa_SendString(lora_msg); // Send over LoRa
      //  printf("LoRa: Sent pressure: %s\r\n", lora_msg);
        return;
    }

    // "LORA SEND GAS": Transmit only gas resistance value via LoRa.
    else if (strcmp(cmd, "LORA SEND GAS") == 0) {
        bme68x_set_op_mode(BME68X_FORCED_MODE, &bme); // Start measurement
        uint32_t delay_us = bme68x_get_meas_dur(BME68X_FORCED_MODE, &conf, &bme) + heatr_conf.heatr_dur * 1000; // Delay
        user_delay_us(delay_us, bme.intf_ptr); // Wait
        uint8_t n_fields = 0;
        if (bme68x_get_data(BME68X_FORCED_MODE, &data, &n_fields, &bme) != BME68X_OK || n_fields == 0) {
            printf("Sensor data not available.\r\n");
            return;
        }
        char lora_msg[32];
        snprintf(lora_msg, sizeof(lora_msg), "G:%.2f", (float)data.gas_resistance); // Format gas
        LoRa_SendString(lora_msg); // Send over LoRa
      //  printf("LoRa: Sent gas: %s\r\n", lora_msg);
        return;
    }

    // "LORA SEND <custom>": Any other string is sent as-is via LoRa.
    else if (strncmp(cmd, "LORA SEND ", 10) == 0) {
        LoRa_SendString(&cmd[10]); // Send whatever comes after "LORA SEND "
      //  printf("LoRa: Sent '%s'\r\n", &cmd[10]); // Print sent text
        return;
    }

    // "LORA STATUS": Read and print LoRa module's SPI status byte.
    else if (strcmp(cmd, "LORA STATUS") == 0) {
        uint8_t status = LoRa_GetStatus(); // Read status via SPI
        printf("SX1262 Status: 0x%02X\r\n", status); // Print in hex
        return;
    }

    // "LORA RESET": Hardware reset + full re-init sequence for LoRa module.
    else if (strcmp(cmd, "LORA RESET") == 0) {
        LoRa_Reset(); // Toggle hardware reset pin
        LoRa_SetStandby(); // Set standby mode
        LoRa_SetPacketType(); // Set LoRa packet mode
        LoRa_SetRfFrequency(868000000); // Set frequency
        LoRa_SetBufferBaseAddress(); // Set buffer addresses
        LoRa_SetModulationParams(); // Set modulation
        LoRa_SetPacketParams(8); // Set packet params (payload len)
        LoRa_SetTxParams(); // Set output power, ramp
        printf("SX1262 Reset done and re-initialized.\r\n"); // Done
        return;
    }

    // "LORA INIT": Run LoRa chip's config/init sequence.
    else if (strcmp(cmd, "LORA INIT") == 0) {
        LoRa_SetStandby(); // Standby mode
        LoRa_SetPacketType(); // LoRa packet
        LoRa_SetRfFrequency(868000000); // Frequency
        LoRa_SetBufferBaseAddress(); // Buffer address
        LoRa_SetModulationParams(); // Modulation params
        LoRa_SetPacketParams(8); // Packet params
        LoRa_SetTxParams(); // TX params
        printf("SX1262 Init sequence completed.\r\n"); // Done
        return;
    }

    // --- Otherwise: read from BME680 and print to UART ---
    bme68x_set_op_mode(BME68X_FORCED_MODE, &bme); // Start sensor measurement
    uint32_t delay_us = bme68x_get_meas_dur(BME68X_FORCED_MODE, &conf, &bme) + heatr_conf.heatr_dur * 1000; // Delay
    user_delay_us(delay_us, bme.intf_ptr); // Wait for conversion
    uint8_t n_fields = 0;
    if (bme68x_get_data(BME68X_FORCED_MODE, &data, &n_fields, &bme) != BME68X_OK || n_fields == 0) {
        printf("Sensor data not available.\r\n"); // Error
        return;
    }
    float temp = data.temperature; // Store temp
    float hum = data.humidity; // Store hum
    float press = data.pressure / 100.0f; // Store pressure
    float gas = (float)data.gas_resistance; // Store gas

    if (strcmp(cmd, "TEMP") == 0) {
        printf("Temperature: %.2f C\r\n", temp); // Print temperature
        return;
    } else if (strcmp(cmd, "HUM") == 0) {
        printf("Humidity: %.2f %%RH\r\n", hum); // Print humidity
        return;
    } else if (strcmp(cmd, "PRESS") == 0) {
        printf("Pressure: %.2f hPa\r\n", press); // Print pressure
        return;
    } else if (strcmp(cmd, "GAS") == 0) {
        printf("Gas Resistance: %.2f Ohms\r\n", gas); // Print gas
        return;
    } else if (strcmp(cmd, "ALL") == 0) {
        printf("Temperature: %.2f C\r\n", temp); // Print temperature
        printf("Humidity:    %.2f %%RH\r\n", hum); // Print humidity
        printf("Pressure:    %.2f hPa\r\n", press); // Print pressure
        printf("Gas:         %.2f Ohms\r\n", gas); // Print gas
        return;
    } else {
        printf("Unknown command: %s\r\n", cmd); // Print unknown
        return;
    }



}




/* ============================================================================
 * UART Receive Interrupt Handler - builds up a user command line
 * ========================================================================= */
volatile uint8_t cmd_ready = 0; // Global flag: set to 1 when a complete command is received

void HAL_UART_RxCpltCallback(UART_HandleTypeDef *huart) {
    // Check if the interrupt is from USART2 (our UART for CLI)
    if (huart->Instance == USART2) {
        // Check if received byte is a line ending (Enter key)
        if (rx_byte == '\r' || rx_byte == '\n') {
            // Only process if command buffer has content
            if (cmd_index > 0) {
                command_buffer[cmd_index] = '\0';  // Null-terminate the command string
                cmd_ready = 1;                     // Set flag to signal command is ready for processing
                cmd_index = 0;                     // Reset buffer index for next command
            }
        } else {
            command_buffer[cmd_index++] = rx_byte; // Add byte to buffer and increment index
            if (cmd_index >= sizeof(command_buffer))
                cmd_index = 0; // Prevent buffer overflow: reset if too long
        }
        HAL_UART_Receive_IT(&huart2, &rx_byte, 1); // Restart UART interrupt to keep receiving
    }
}



volatile uint8_t system_started = 0; // 0 = not started, 1 = started

/* USER CODE END 0 */

/* ============================================================================
 * MAIN ENTRY POINT - sets up everything, then runs main loop
 * ========================================================================= */
int main(void)
{

  /* USER CODE BEGIN 1 */

  /* USER CODE END 1 */

  /* MCU Configuration--------------------------------------------------------*/

  /* Reset of all peripherals, Initializes the Flash interface and the Systick. */
	HAL_Init();                                // STM32 HAL and hardware abstraction init

  /* USER CODE BEGIN Init */

  /* USER CODE END Init */

  /* Configure the system clock */
	SystemClock_Config();                      // Set up system clock (from CubeMX)

  /* USER CODE BEGIN SysInit */

  /* USER CODE END SysInit */

  /* Initialize all configured peripherals */
	MX_GPIO_Init();                            // Initialize GPIOs (including SPI/I2C)
	MX_I2C1_Init();                            // Set up I2C1 (BME680 sensor)
	MX_USART2_UART_Init();                     // Set up USART2 for UART CLI
	MX_SPI2_Init();                            // Set up SPI2 for LoRa HAT
  /* USER CODE BEGIN 2 */

	printf("ENTER START TO START YOUR NUCLEO.\r\n");
	HAL_UART_Receive_IT(&huart2, &rx_byte, 1);




  /* USER CODE END 2 */

  /* Infinite loop */
  /* USER CODE BEGIN WHILE */
  while (1)
  {
	  if (cmd_ready) {                                   // Check if a full user command has been received via UART
	      if (!system_started) {                         // If system is NOT started (waiting for "START" command)
	          if (strcmp(command_buffer, "START") == 0) { // If the received command is "START"
	              system_started = 1;                    // Set flag to indicate system has now started
	              handle_command("START");               // Run initialization/start logic in command handler
	          } else {
	              printf("ENTER START TO START YOUR NUCLEO.\r\n"); // Prompt user to type START if they send any other command
	          }
	      } else {                                       // If system is already started (normal mode)
	          printf("Command received: %s\r\n", command_buffer); // Print received command for user feedback
	          handle_command(command_buffer);            // Pass the command string to be processed
	      }
	      cmd_ready = 0;                                 // Reset the command ready flag so we can process next command
	  }
	  HAL_Delay(10);                                     // Small delay to prevent CPU overuse (reduce busy-waiting)

    /* USER CODE END WHILE */

    /* USER CODE BEGIN 3 */
  }
  /* USER CODE END 3 */
}

/**
  * @brief System Clock Configuration
  * @retval None
  */
void SystemClock_Config(void)
{
  RCC_OscInitTypeDef RCC_OscInitStruct = {0};
  RCC_ClkInitTypeDef RCC_ClkInitStruct = {0};

  /** Configure the main internal regulator output voltage
  */
  HAL_PWREx_ControlVoltageScaling(PWR_REGULATOR_VOLTAGE_SCALE1);

  /** Initializes the RCC Oscillators according to the specified parameters
  * in the RCC_OscInitTypeDef structure.
  */
  RCC_OscInitStruct.OscillatorType = RCC_OSCILLATORTYPE_HSI;
  RCC_OscInitStruct.HSIState = RCC_HSI_ON;
  RCC_OscInitStruct.HSIDiv = RCC_HSI_DIV1;
  RCC_OscInitStruct.HSICalibrationValue = RCC_HSICALIBRATION_DEFAULT;
  RCC_OscInitStruct.PLL.PLLState = RCC_PLL_NONE;
  if (HAL_RCC_OscConfig(&RCC_OscInitStruct) != HAL_OK)
  {
    Error_Handler();
  }

  /** Initializes the CPU, AHB and APB buses clocks
  */
  RCC_ClkInitStruct.ClockType = RCC_CLOCKTYPE_HCLK|RCC_CLOCKTYPE_SYSCLK
                              |RCC_CLOCKTYPE_PCLK1;
  RCC_ClkInitStruct.SYSCLKSource = RCC_SYSCLKSOURCE_HSI;
  RCC_ClkInitStruct.AHBCLKDivider = RCC_SYSCLK_DIV1;
  RCC_ClkInitStruct.APB1CLKDivider = RCC_HCLK_DIV1;

  if (HAL_RCC_ClockConfig(&RCC_ClkInitStruct, FLASH_LATENCY_0) != HAL_OK)
  {
    Error_Handler();
  }
}

/* USER CODE BEGIN 4 */

/* USER CODE END 4 */

/**
  * @brief  This function is executed in case of error occurrence.
  * @retval None
  */
void Error_Handler(void)
{
  /* USER CODE BEGIN Error_Handler_Debug */
  /* User can add his own implementation to report the HAL error return state */
  __disable_irq();
  while (1)
  {
  }
  /* USER CODE END Error_Handler_Debug */
}
#ifdef USE_FULL_ASSERT
/**
  * @brief  Reports the name of the source file and the source line number
  *         where the assert_param error has occurred.
  * @param  file: pointer to the source file name
  * @param  line: assert_param error line source number
  * @retval None
  */
void assert_failed(uint8_t *file, uint32_t line)
{
  /* USER CODE BEGIN 6 */
  /* User can add his own implementation to report the file name and line number,
     ex: printf("Wrong parameters value: file %s on line %d\r\n", file, line) */
  /* USER CODE END 6 */
}
#endif /* USE_FULL_ASSERT */
